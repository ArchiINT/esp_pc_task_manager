## components/pcmon_display/Kconfig
```kconfig
menu "PC Monitor: display (ST7789)"

    comment "Wiring - defaults match the ESP32-S3 SuperMini reference build"

    config PCMON_LCD_PIN_SCLK
        int "SPI SCLK (display SCL/CLK)"
        range 0 48
        default 1

    config PCMON_LCD_PIN_MOSI
        int "SPI MOSI (display SDA/DIN)"
        range 0 48
        default 2

    config PCMON_LCD_PIN_RST
        int "Reset (RES), -1 if tied to EN"
        range -1 48
        default 3

    config PCMON_LCD_PIN_DC
        int "Data/Command (DC)"
        range 0 48
        default 4

    config PCMON_LCD_PIN_CS
        int "Chip select (CS), -1 if tied to GND"
        range -1 48
        default 5

    config PCMON_LCD_PIN_BL
        int "Backlight (BLK), -1 if always on"
        range -1 48
        default 6

    config PCMON_LCD_BL_ACTIVE_LOW
        bool "Backlight is active low"
        default n

    config PCMON_BUTTON_GPIO
        int "Page button GPIO (-1 to disable)"
        range -1 48
        default 7
        help
            Short press switches to the next page, long press (>1 s) toggles
            automatic page cycling.  The pin is driven with an internal pull-up
            and is expected to be pulled to GND when pressed, so a bare tact
            switch between the pin and GND is all it takes.

            GPIO7 rather than the BOOT button: the SuperMini does not break
            GPIO0 out to a header.

    comment "Panel"

    config PCMON_LCD_H_RES
        int "Horizontal resolution"
        default 240

    config PCMON_LCD_V_RES
        int "Vertical resolution"
        default 320

    config PCMON_LCD_X_GAP
        int "Panel X offset"
        default 0
        help
            A 240x320 module uses the controller's frame buffer end to end, so
            no offset is needed.  Cropped panels (240x240, 135x240) expose it
            with a gap - increase if the image is shifted horizontally.

    config PCMON_LCD_Y_GAP
        int "Panel Y offset"
        default 0

    config PCMON_LCD_MIRROR_X
        bool "Mirror horizontally"
        default n

    config PCMON_LCD_MIRROR_Y
        bool "Mirror vertically"
        default n

    config PCMON_LCD_SWAP_XY
        bool "Swap X and Y (rotate 90 degrees)"
        default n

    config PCMON_LCD_INVERT_COLOR
        bool "Invert colors"
        default n
        help
            Off for the 2.8" 240x320 reference panel, which already comes up
            inverted.  Most 240x240 IPS ST7789 modules need it on instead - turn
            it on if the image comes out as a photo negative (white background
            under the dark theme).

    config PCMON_LCD_PIXEL_CLOCK_MHZ
        int "SPI pixel clock, MHz"
        range 10 80
        default 40
        help
            40 MHz is safe with jumper wires.  Short, well routed traces usually
            tolerate 60-80 MHz, which roughly halves the full-frame flush time.

    config PCMON_LCD_BUFFER_LINES
        int "LVGL draw buffer height, lines"
        range 10 320
        default 48
        help
            Two buffers of H_RES x this many pixels are allocated in internal
            DMA-capable RAM (240 x 48 x 2 B = 23 kB each by default).

    config PCMON_LCD_BRIGHTNESS
        int "Default backlight brightness, %"
        range 0 100
        default 85

    config PCMON_LCD_SELFTEST
        bool "Paint solid colour screens at boot"
        default n
        help
            Before LVGL starts, fill the panel with red, green, blue and white
            for about a second each, straight through esp_lcd.  Seeing the four
            colours proves the wiring and the ST7789 init sequence, which
            narrows a blank screen down to the UI layer.

endmenu
```

## components/pcmon_link/Kconfig
```kconfig
menu "PC Monitor: host link"

    choice PCMON_LINK_TRANSPORT
        prompt "Transport to the PC"
        default PCMON_LINK_USB
        help
            How telemetry reaches the board.

            USB is the recommended default: the board is powered from the same
            cable, latency is sub-millisecond and no pairing is involved.

            BLE requires the NimBLE stack; build with
            "idf.py -D SDKCONFIG_DEFAULTS='sdkconfig.defaults;sdkconfig.defaults.ble' build"
            so that Bluetooth is enabled in the low-level configuration as well.

        config PCMON_LINK_USB
            bool "USB (native USB-Serial-JTAG)"

        config PCMON_LINK_BLE
            bool "Bluetooth LE (NimBLE, Nordic UART Service)"
    endchoice

    config PCMON_LINK_TIMEOUT_MS
        int "Host timeout, ms"
        range 500 60000
        default 3000
        help
            If no valid frame arrives within this window the link is considered
            down and the UI switches to the "waiting for host" state.

    config PCMON_LINK_TASK_STACK
        int "Transport task stack size, bytes"
        range 2048 16384
        default 4096

    config PCMON_LINK_TASK_PRIO
        int "Transport task priority"
        range 1 20
        default 5
        help
            Kept above the UI task so that decoding never waits on rendering.

    config PCMON_BLE_DEVICE_NAME
        string "BLE advertised name"
        depends on PCMON_LINK_BLE
        default "ESP-PCMON"

endmenu
```

## components/pcmon_ui/Kconfig
```kconfig
menu "PC Monitor: user interface"

    config PCMON_UI_TASK_STACK
        int "UI task stack size, bytes"
        range 4096 32768
        default 8192

    config PCMON_UI_TASK_PRIO
        int "UI task priority"
        range 1 20
        default 4
        help
            Below the transport task: decoding must never wait for a repaint.

    config PCMON_UI_AUTOCYCLE_MS
        int "Automatic page cycling interval, ms (0 = off)"
        range 0 600000
        default 0
        help
            Off by default: pages change on the button only.  Set a non-zero
            interval to have them advance on their own as well, in which case a
            long press toggles the cycling at runtime.

endmenu
```
